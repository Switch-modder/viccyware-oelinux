## poky/meta-wireos/conf/layer.conf
```bitbake
# We have a conf and classes directory, add to BBPATH
BBPATH .= ":${LAYERDIR}"

# We have recipes-* directories, add to BBFILES
BBFILES += "${LAYERDIR}/recipes*/*/*.bb \
	${LAYERDIR}/recipes*/*/*.bbappend"

BBFILE_COLLECTIONS += "wireos"
BBFILE_PATTERN_wireos = "^${LAYERDIR}/"
BBFILE_PRIORITY_wireos = "13"

IMAGE_INSTALL_append = " wired sb-server sysswitch"

# Only run lo][fcalsshuser recipe when the image has local ssh
#IMAGE_INSTALL_append += "${@base_conditional('USER_BUILD', '1', '', 'localsshuser', d)}"
#IMAGE_INSTALL_append += "${@base_conditional('DEV', '1', 'localsshuser', '', d)}"
```
